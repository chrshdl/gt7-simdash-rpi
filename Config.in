## Config.in
```kconfig
source "$BR2_EXTERNAL_GT7_SIMDASH_PATH/package/brcmfmac-firmware/Config.in"
source "$BR2_EXTERNAL_GT7_SIMDASH_PATH/package/python-granturismo/Config.in"
source "$BR2_EXTERNAL_GT7_SIMDASH_PATH/package/python-gt7-simdash/Config.in"
source "$BR2_EXTERNAL_GT7_SIMDASH_PATH/package/python-salsa20/Config.in"
source "$BR2_EXTERNAL_GT7_SIMDASH_PATH/package/python-marshmallow-dataclass/Config.in"
source "$BR2_EXTERNAL_GT7_SIMDASH_PATH/package/python-pygame-261/Config.in"
```

## br2-external/package/gt7-simdash/Config.in
```kconfig
config BR2_PACKAGE_GT7_SIMDASH
    bool "gt7-simdash"
    help
      Install GT7 SimDash Python application.
      Depends on Python 3 and Pygame.
```

## configs/raspberrypi4_defconfig
```kconfig
# Platform and toolchain
BR2_arm=y
BR2_cortex_a72=y
BR2_ARM_FPU_NEON_VFPV4=y

BR2_TOOLCHAIN_BUILDROOT_GLIBC=y
BR2_SYSTEM_DHCP="eth0"

BR2_TARGET_GENERIC_GETTY_PORT="tty1"

# Enable Python 3.11 and pip support
BR2_PACKAGE_PYTHON3=y
BR2_PACKAGE_PYTHON3_PIP=y

# RPi 4 firmware, boot partition size, and config.txt
BR2_PACKAGE_RPI_FIRMWARE=y
BR2_PACKAGE_RPI_FIRMWARE_CONFIG_FILE="board/raspberrypi4/config.txt"
BR2_TARGET_RPI_BOOT_PARTITION_SIZE=256

# Kernel and kernel fragment for DSI/LCD/touch etc.
BR2_LINUX_KERNEL=y
BR2_LINUX_KERNEL_USE_DEFCONFIG=y
BR2_LINUX_KERNEL_DEFCONFIG="bcm2711_defconfig"
BR2_LINUX_KERNEL_CONFIG_FRAGMENT_FILES="board/raspberrypi4/linux-fragment.config"
BR2_LINUX_KERNEL_DTS_SUPPORT=y
BR2_LINUX_KERNEL_INTREE_DTS_NAME="bcm2711-rpi-4-b"

# WiFi + tools
BR2_PACKAGE_LINUX_FIRMWARE=y
BR2_PACKAGE_LINUX_FIRMWARE_BRCM_BCM43XXX=y
BR2_PACKAGE_WPA_SUPPLICANT=y
BR2_PACKAGE_WPA_SUPPLICANT_CLI=y
# BR2_PACKAGE_WPA_SUPPLICANT_DBUS=y
BR2_PACKAGE_WIRELESS_TOOLS=y
BR2_PACKAGE_DHCPCD=y

# Pygame and dependencies (SDL2 etc.)
BR2_PACKAGE_SDL2=y
BR2_PACKAGE_SDL2_IMAGE=y
BR2_PACKAGE_SDL2_IMAGE_PNG=y
BR2_PACKAGE_SDL2_IMAGE_JPEG=y
BR2_PACKAGE_SDL2_TTF=y
BR2_PACKAGE_SDL2_MIXER=y
BR2_PACKAGE_PYTHON_PYGAME=y
BR2_PACKAGE_PYTHON_PYGAME_FONT=y
BR2_PACKAGE_PYTHON_PYGAME_MIXER=y

# Add git so pip can install from github
BR2_PACKAGE_GIT=y

# gt7-simdash (external BR2 tree)
BR2_EXTERNAL=../br2-external
BR2_PACKAGE_GT7_SIMDASH=y
```

## package/python-granturismo/Config.in
```kconfig
config BR2_PACKAGE_PYTHON_GRANTURISMO
    bool "python-granturismo"
    select BR2_PACKAGE_PYTHON_SALSA20
    select BR2_PACKAGE_PYTHON_MARSHMALLOW_DATACLASS
    help
      Gran Turismo 7 Telemetry Library
      https://github.com/chrshdl/granturismo
```

## package/python-gt7-simdash/Config.in
```kconfig
config BR2_PACKAGE_PYTHON_GT7_SIMDASH
    bool "python-gt7-simdash"
    depends on BR2_PACKAGE_PYTHON3
    select BR2_PACKAGE_PYTHON_PYGAME_261
    select BR2_PACKAGE_GRANTURISMO
    help
      Gran Turismo 7 Instrument Cluster (gt7-simdash)
      https://github.com/chrshdl/gt7-simdash
```

## package/python-marshmallow-dataclass/Config.in
```kconfig
config BR2_PACKAGE_PYTHON_MARSHMALLOW_DATACLASS
	bool "python-marshmallow-dataclass"
	select BR2_PACKAGE_PYTHON3
	help
	  Automatic generation of marshmallow schemas from dataclasses.
```

## package/python-salsa20/Config.in
```kconfig
config BR2_PACKAGE_PYTHON_SALSA20
	bool "python-salsa20"
	select BR2_PACKAGE_PYTHON3
	help
	  Bindings for the NaCL implementation of Salsa20 and
	  XSalsa20 by D. J. Bernstein.
```
